/dts-v1/;
/plugin/;

/ {
    compatible = "brcm,bcm2835";  // Raspberry Pi SoCs

    fragment@0 {
        target = <&spidev0>;      // Disable default spidev0
        __overlay__ {
            status = "disabled";
        };
    };

    fragment@1 {
        target = <&spi0>;         // Use SPI0 controller
        __overlay__ {
            #address-cells = <1>;
            #size-cells = <0>;
            status = "okay";

            w5500_eth: ethernet@0 {
                compatible = "custom,w5500-ethernet";   
                reg = <0>;                              // CS0
                spi-max-frequency = <8000000>;
                spi-mode = <0>;
                reset-gpios = <&gpio 24 1>;             // Reset pin, GPIO24, active low
                interrupt-parent = <&gpio>;
                interrupts = <25 8>;   // INTn pin,GPIO25, low level
            };
        };
    };
};
